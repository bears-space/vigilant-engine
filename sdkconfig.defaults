## sdkconfig.defaults
```kconfig
#Uncomment and change these to your flash size if you experience issues!
#CONFIG_ESPTOOLPY_FLASHSIZE_4MB=y
#CONFIG_ESPTOOLPY_FLASHSIZE="4MB"

#
# Partition Table
#
# CONFIG_PARTITION_TABLE_SINGLE_APP is not set
# CONFIG_PARTITION_TABLE_SINGLE_APP_LARGE is not set
# CONFIG_PARTITION_TABLE_TWO_OTA is not set
# CONFIG_PARTITION_TABLE_TWO_OTA_LARGE is not set
CONFIG_PARTITION_TABLE_CUSTOM=y
CONFIG_PARTITION_TABLE_CUSTOM_FILENAME="partitions.csv"
CONFIG_PARTITION_TABLE_FILENAME="partitions.csv"
CONFIG_PARTITION_TABLE_OFFSET=0x8000
CONFIG_PARTITION_TABLE_MD5=y
# end of Partition Table

#
# HTTP Server
#
CONFIG_HTTPD_MAX_REQ_HDR_LEN=1024
CONFIG_HTTPD_MAX_URI_LEN=512
CONFIG_HTTPD_ERR_RESP_NO_DELAY=y
CONFIG_HTTPD_PURGE_BUF_LEN=32
# CONFIG_HTTPD_LOG_PURGE_DATA is not set
CONFIG_HTTPD_WS_SUPPORT=y
# CONFIG_HTTPD_QUEUE_WORK_BLOCKING is not set
CONFIG_HTTPD_SERVER_EVENT_POST_TIMEOUT=2000
# CONFIG_HTTPD_WS_PRE_HANDSHAKE_CB_SUPPORT is not set
# end of HTTP Server

#Avoid Status LED conflicts
#CONFIG_ESP_CONSOLE_SECONDARY_USB_SERIAL_JTAG=n
# !!! THIS LINE IS COMMENTED OUT ON PURPOSE !!! For booleans set to off, the expected form is # CONFIG_NAME is not set, not CONFIG_NAME=n

#To enable logging while using the timer
#Weirdly also fixes the serial time out?
CONFIG_FREERTOS_TIMER_TASK_STACK_DEPTH=4096
```
