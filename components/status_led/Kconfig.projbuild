## components/status_led/Kconfig.projbuild
```kconfig
menu "Vigilant Engine Configuration: LEDs"
    config VE_ENABLE_STATUS_LED
        bool "Enable Status LED"
        default y
        help
            Enable this option to use the status LED functionality in Vigilant Engine.
            The status LED provides visual feedback on the system's status and operations, and can optionally be used for visual output.

    choice VE_LED_TYPE
        prompt "LED Type"
        default VE_LED_TYPE_WS2812B
        depends on VE_ENABLE_STATUS_LED
        help
            Select the type of LED functionality to enable in Vigilant Engine.

        config VE_LED_TYPE_WS2812B
            bool "WS2812B LED"

    endchoice

    config VE_STATUS_WS2812B_PIN
        int "WS2812B Data Pin"
        default 8
        depends on VE_LED_TYPE_WS2812B

    config VE_LOG_INFO_PULSE_MS
        int "Log Info Pulse Duration (ms)"
        default 35
        depends on VE_ENABLE_STATUS_LED
        help
            Set the duration of the pulse for log info events in milliseconds.

    config VE_LOG_WARN_PULSE_MS
        int "Log Warning Pulse Duration (ms)"
        default 80
        depends on VE_ENABLE_STATUS_LED
        help
            Set the duration of the pulse for log warning events in milliseconds.

    config VE_LOG_ERROR_PULSE_MS
        int "Log Error Pulse Duration (ms)"
        default 200
        depends on VE_ENABLE_STATUS_LED
        help
            Set the duration of the pulse for log error events in milliseconds.

    config VE_LED_COLOR_INFO
        hex "LED color INFO (hex)"
        range 0x000000 0xFFFFFF
        default 0x40F284
        help
            RGB color in hex format used to show INFO logs.

    config VE_LED_COLOR_WARNING
        hex "LED color WARNING (hex)"
        range 0x000000 0xFFFFFF
        default 0xFFFF00
        help
            RGB color in hex format used to show WARN logs.

    config VE_LED_COLOR_ERROR
        hex "LED color ERROR (hex)"
        range 0x000000 0xFFFFFF
        default 0xFF0000
        help
            RGB color in hex format used to show ERROR logs.

endmenu
```

## components/tcan4550/Kconfig
```kconfig
menu "TCAN4550 Configuration"
    config TCAN4550_CS_IO
        int "Chip select GPIO"
        range 0 SOC_GPIO_OUT_RANGE_MAX
        default 10
        help
            GPIO number for nCS, not a package pin number.

    config TCAN4550_MOSI_IO
        int "MOSI GPIO"
        range 0 SOC_GPIO_OUT_RANGE_MAX
        default 11
        help
            GPIO number for SDI/MOSI, not a package pin number.

    config TCAN4550_SCLK_IO
        int "SPI clock GPIO"
        range 0 SOC_GPIO_OUT_RANGE_MAX
        default 12
        help
            GPIO number for SCLK, not a package pin number.

    config TCAN4550_MISO_IO
        int "MISO GPIO"
        range 0 SOC_GPIO_IN_RANGE_MAX
        default 13
        help
            GPIO number for SDO/MISO, not a package pin number.

    config TCAN4550_DEFAULT_TX_ID
        hex "Default transmit CAN ID"
        range 0x0 0x1FFFFFFF
        default 0x123
        help
            Default CAN arbitration ID for application transmit frames.
            Use CONFIG_TCAN4550_DEFAULT_TX_ID when initializing a frame's id.
            IDs above 0x7FF require the frame's extended flag to be true.
            Explicit frame IDs and receive filters are unaffected.
endmenu
```

## main/Kconfig.projbuild
```kconfig
menu "Vigilant Engine Configuration: WiFi"
    depends on SOC_WIFI_SUPPORTED

    # --- Wifi Settings ---
    config VE_STA_SSID
        string "WiFi STA SSID"
        default "starstreak"
        help
            The SSID of the WiFi network the Vigilant Engine should connect to.
    config VE_STA_PASSWORD
        string "WiFi STA Password"
        default "starstreak"
        help
            The password for the WiFi network the Vigilant Engine should connect to.
    config VE_STA_RECONNECT_INTERVAL_MS
        int "WiFi STA Reconnect Interval (ms)"
        default 3000
        help
            The interval in milliseconds for attempting to reconnect to the WiFi network when the connection is lost in STA mode.
    config VE_AP_SSID_PREFIX
        string "WiFi AP SSID Prefix"
        default "starstreak-"
        help
            The prefix for the SSID of the WiFi Access Point (AP) mode of the Vigilant Engine. The full SSID will be generated by appending the device's MAC address to this prefix.
    config VE_AP_PASSWORD
        string "WiFi AP Password"
        default "starstreak"
        help
            The password for the WiFi Access Point (AP) mode of the Vigilant Engine.
endmenu

rsource "../vigilant-engine-recovery/Kconfig.network"

menu "Vigilant Engine Configuration: I2C"
    config VE_ENABLE_I2C
        bool "Enable I2C"
        default n
        help
            Enable this option to use I2C functionality in Vigilant Engine.

    config VE_I2C_SCL_IO
        int "I2C SCL GPIO"
        range 0 64
        default 0
        depends on VE_ENABLE_I2C
        help
            The GPIO pin for the I2C SCL signal.

    config VE_I2C_SDA_IO
        int "I2C SDA GPIO"
        range 0 64
        default 1
        depends on VE_ENABLE_I2C
        help
            The GPIO pin for the I2C SDA signal.

    config VE_I2C_FREQ_HZ
        int "I2C Frequency (Hz)"
        default 100000
        depends on VE_ENABLE_I2C
        help
            The frequency of the I2C communication in Hertz. Common values are 100000 (100 kHz) for standard mode and 400000 (400 kHz) for fast mode.
endmenu

menu "Vigilant Engine Configuration: Frontend"
    config VE_DISABLE_FRONTEND
        bool "Disable Frontend Embedded HTML"
        default n
        help
            Enable this option to disable the frontend functionality in Vigilant Engine. This is useful for headless operation or when the frontend is not needed. Note: this only removes the html embedded in the firmware, the api routes are still available.
endmenu
```

## vigilant-engine-recovery/Kconfig.network
```kconfig
menu "Vigilant Engine Configuration: Recovery"
    depends on SOC_WIFI_SUPPORTED

    choice VE_RECOVERY_NETWORK_MODE
        prompt "Recovery network mode"
        default VE_RECOVERY_NETWORK_MODE_AP
        help
            Select how the recovery firmware connects to WiFi. AP creates a
            recovery access point, STA joins an existing network, and AP+STA
            enables both interfaces.

        config VE_RECOVERY_NETWORK_MODE_AP
            bool "AP"

        config VE_RECOVERY_NETWORK_MODE_STA
            bool "STA"

        config VE_RECOVERY_NETWORK_MODE_APSTA
            bool "AP+STA"
    endchoice

    config VE_RECOVERY_STA_SSID
        string "Recovery STA SSID"
        default "starstreak"
        depends on VE_RECOVERY_NETWORK_MODE_STA || VE_RECOVERY_NETWORK_MODE_APSTA
        help
            The SSID of the WiFi network the recovery firmware should join.

    config VE_RECOVERY_STA_PASSWORD
        string "Recovery STA password"
        default "starstreak"
        depends on VE_RECOVERY_NETWORK_MODE_STA || VE_RECOVERY_NETWORK_MODE_APSTA
        help
            The password of the WiFi network the recovery firmware should
            join. Leave empty for an open network.

    config VE_RECOVERY_AP_SSID_PREFIX
        string "Recovery AP SSID prefix"
        default "VE-Recovery-"
        depends on VE_RECOVERY_NETWORK_MODE_AP || VE_RECOVERY_NETWORK_MODE_APSTA
        help
            Prefix for the recovery access point SSID. The last two bytes of
            the device MAC address are appended to keep the SSID unique.

    config VE_RECOVERY_AP_PASSWORD
        string "Recovery AP password"
        default "starstreak"
        depends on VE_RECOVERY_NETWORK_MODE_AP || VE_RECOVERY_NETWORK_MODE_APSTA
        help
            Password for the recovery access point. Use either an empty value
            for an open access point or a password between 8 and 63 characters.

    config VE_RECOVERY_AP_CHANNEL
        int "Recovery AP WiFi channel"
        range 1 14
        default 6
        help
            WiFi channel used by the recovery access point.

    config VE_RECOVERY_MAX_CONN
        int "Recovery AP maximum connections"
        range 1 15
        default 2
        help
            Maximum number of stations that may connect to the recovery
            access point simultaneously.

    config VE_RECOVERY_CONNECTION_TIMEOUT_SECONDS
        int "Recovery STA connection timeout (seconds)"
        range 1 3600
        default 10
        help
            Number of seconds to wait for the recovery station interface to
            connect before continuing without a station connection.
endmenu
```
